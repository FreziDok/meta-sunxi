## conf/machine/include/sun55i.inc
```bitbake
require conf/machine/include/sunxi64.inc

DEFAULTTUNE ?= "cortexa55"
require conf/machine/include/arm/armv8-2a/tune-cortexa55.inc

SOC_FAMILY = "sun55i"
```
